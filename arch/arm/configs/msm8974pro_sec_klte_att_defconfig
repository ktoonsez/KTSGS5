## arch/arm/configs/msm8974pro_sec_klte_att_defconfig
```kconfig
# K PROJECT config
CONFIG_ARCH_MSM8974PRO=y
CONFIG_SEC_K_PROJECT=y
CONFIG_MACH_KLTE_ATT=y
CONFIG_WLAN_REGION_CODE=401
```

## arch/arm/configs/msm8974pro_sec_klte_mtr_defconfig
```kconfig
# K PROJECT config
CONFIG_ARCH_MSM8974PRO=y
CONFIG_SEC_K_PROJECT=y
CONFIG_MACH_KLTE_MTR=y
CONFIG_WLAN_REGION_CODE=407
```

## arch/arm/configs/msm8974pro_sec_klte_usc_defconfig
```kconfig
# K PROJECT config
CONFIG_ARCH_MSM8974PRO=y
CONFIG_SEC_K_PROJECT=y
CONFIG_MACH_KLTE_USC=y
CONFIG_WLAN_REGION_CODE=100
```
